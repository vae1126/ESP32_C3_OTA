## components/led_control/Kconfig
```kconfig
menu "LED Control"
    config LED_PWM_R_GPIO
        int "PWM Red GPIO"
        range 0 39
        default 3
    config LED_PWM_G_GPIO
        int "PWM Green GPIO"
        range 0 39
        default 4
    config LED_PWM_B_GPIO
        int "PWM Blue GPIO"
        range 0 39
        default 5
    config LED_WS2812_GPIO
        int "WS2812 GPIO"
        range 0 39
        default 8
    config LED_WS2812_NUM
        int "WS2812 LED count"
        range 1 256
        default 16
endmenu
```

## components/mqtt_ha/Kconfig
```kconfig
config MQTT_BROKER_URL
    string "MQTT Broker URL"
    default "mqtt://47.121.26.212:1883"
```

## components/ota_handler/Kconfig
```kconfig
menu "OTA Upgrade Configuration"

    config OTA_SERVER_URL
        string "OTA Server Base URL"
        default "http://47.121.26.212:5000"
        help
            The base URL of the OTA firmware management server.
            Example: http://your-server.com or http://192.168.1.100:5000

    config OTA_CHECK_INTERVAL_MIN
        int "Auto check interval (minutes)"
        default 120
        range 10 1440
        help
            How often the device checks for new firmware.
            Default: 120 minutes (2 hours).

    config OTA_AUTO_UPGRADE
        bool "Enable auto upgrade"
        default y
        help
            If enabled, the device will automatically download and apply
            firmware updates when a new version is detected.

    config OTA_API_TOKEN
        string "API Token for device authentication"
        default "ota-api-token-2024"
        help
            The API token used to authenticate with the OTA server.
            Must match the server's config.API_TOKEN.

    config OTA_HTTP_TIMEOUT_MS
        int "HTTP request timeout (ms)"
        default 30000
        range 5000 120000
        help
            Timeout for firmware download HTTP requests.

endmenu
```
